  double coef[] = {-0.0000,   -0.0029,   -0.0000,   -0.0049,   -0.0000,   -0.0091,   -0.0000,   -0.0162,   -0.0000,   -0.0271,   -0.0000,   -0.0433,   -0.0000,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    0.0029,    0.0000};
  int coefLen = 41;
  double x[] = {0,    0.1572,    0.3105,    0.4561,    0.5903,    0.7099,    0.8118,    0.8935,    0.9530,    0.9888,    1.0000,    0.9863,    0.9481,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   -0.1572,   -0.0000};
  int xLen = 200; 
  

  int i, j, k;
  double tmp;
  double out[] = {0,     0,     0,     0,     0,     0,     0,     0,     0,     0,     0,     0,     0,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     0,     0};
  double real[] = {0,     0,     0,     0,     0,     0,     0,     0,     0,     0,     0,     0,     0,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     0,     0};
  double imag[] = {0,     0,     0,     0,     0,     0,     0,     0,     0,     0,     0,     0,     0,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     0,     0};
  double mag[] = {0,     0,     0,     0,     0,     0,     0,     0,     0,     0,     0,     0,     0,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     0,     0};
  double realDIV[] = {0,     0,     0,     0,     0,     0,     0,     0,     0,     0,     0,     0,     0,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     0,     0};
  double imagDIV[] = {0,     0,     0,     0,     0,     0,     0,     0,     0,     0,     0,     0,     0,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     0,     0};
  double phase[] = {0,     0,     0,     0,     0,     0,     0,     0,     0,     0,     0,     0,     0,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     0,     0};

  
void setup() {
Serial.begin(115200);

  for (k = 0; k < xLen; k++)  //  position in output
  {
    tmp = 0;

    for (i = 0; i < coefLen; i++)  //  position in coefficients array
    {
      j = k - i;  //  position in input

      if (j >= 0)  //  bounds check for input buffer
      {
        tmp += coef[i] * x[j];
      }
    }

    out[k] = tmp;
  }

  for(int p = 0; p < 200; p++){
    if(p < 180) {
      real[p] = x[p];
    }
    if(p > 19) {
      imag[p] = out[p];
    }
  }

    for(int a = 0; a < 200; a++) {
    mag[a] = sqrt((real[a] * real[a]) + (imag[a] * imag[a]));
    realDIV[a] = real[a] / mag[a];
    imagDIV[a] = imag[a] / mag[a];
    phase[a] = log(imagDIV[a]);
    Serial.print(x[a]);
    Serial.print(",");
    Serial.println(out[a]);
    //Serial.print(",");
    //Serial.println(phase[a]);
  }
  






  }




void loop() {

}
