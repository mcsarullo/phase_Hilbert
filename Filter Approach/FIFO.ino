#include "KickFilters.h"


  int samples = 1200;
  double coef[] = {-6.5768e-31, -0.00010207, -4.9525e-31, -0.00010258, -3.5557e-31, -0.00010318, -2.3863e-31, -0.00010388, -1.4454e-31, -0.00010468, -7.3547e-32, -0.00010558, -2.6047e-32,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 0.00010207, 6.5768e-31};
  int coefLen = 1001; 
  const float sampleAnalog[] = {3.00,2.00,0.00,0.00,0.00,2.00,5.00,7.00,10.00,14.00,19.00,24.00,31.00,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1.00,0.00};
  float filtered[1200] = {0};
  float tmpArr[1200] = {0};
  float fs = 1250;

  int i,j,k;
  double tmp = 0;
double out[1200] = {0};
double real[1200] = {0};
double imag[1200] = {0};
float buf[1200] = {0};
int counter = 0;


void setup() {
  Serial.begin(115200);


for(int l = 0; l < samples; l++) {
  buf[l] = sampleAnalog[l];
}


}

void loop() {




//Serial.println(millis());
for(int p = 0; p < samples - 1; p++) {
  buf[p] = buf[p+1];
}

buf[samples - 1] = sampleAnalog[samples + counter];


  KickFilters<float>::bandpass(buf, filtered, tmpArr, samples, 1,20 , fs); // BANDPASS HERE. Parameters: (input, output, temp (just required, no purpose afterwards), sample #, highpass, lowpass, Samp. Freq.)
  
  for (k = 0; k < samples; k++)  //  position in output
  {
    tmp = 0;

    for (i = 0; i < coefLen; i++)  //  position in coefficients array
    {
      j = k - i;  //  position in input

      if (j >= 0)  //  bounds check for input buffer
      {
        tmp += coef[i] * filtered[j+21];
      }
    }

    out[k] = tmp;
  }

    for(int p = 0; p < samples; p++){
    if(p < samples - ((coefLen-1)/2)) {
      real[p] = filtered[p];
    }
    if(p > ((coefLen-1)/2)-1){
      imag[p] = out[p];
    }
  }

double p = atan2(imag[samples - ((coefLen - 1)/2) - 1],real[samples- ((coefLen - 1)/2) - 1]);

//Serial.println(millis());



//Serial.print(buf[samples -1]/200);  
//Serial.print(",");


Serial.print(filtered[samples -1]/100);
Serial.print(",");
Serial.println(p);

counter++;
}
