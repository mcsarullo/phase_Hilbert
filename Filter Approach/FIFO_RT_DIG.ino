#include "KickFiltersRT.h"
KickFiltersRT<float> filtersRT;

  int samples = 700;
  double coef[] = {-3.2884e-31, -0.00020463, -1.7779e-31, -0.00020704, -7.2268e-32, -0.00021023, -1.3023e-32, -0.00021425, -1.8787e-33, -0.00021909, -4.124e-31, -0.00022478, -2.3836e-31,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 0.00020463, 3.2884e-31};
  int coefLen = 501; 
  //const float sampleAnalog[] = {3.00,2.00,0.00,0.00,0.00,2.00,5.00,7.00,10.00,14.00,19.00,24.00,31.00,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1.00,0.00};
  float filtered[700] = {0};
  float tmpArr[700] = {0};
  float fs = 600;
  int inc = 1;

  int i,j,k;
  double tmp = 0;
double out[700] = {0};
double real[700] = {0};
double imag[700] = {0};
float buf[700] = {0};
int counter = 0; 
int digCheck = 0;
const int pinNumber = 0;
double desiredPhase;

void setup() {
  Serial.begin(115200);
  analogReadAveraging(3);
  analogReadResolution(8);


for(int l = 0; l < samples; l++) { // This loop fills the buffer so that the hilbert convolution works properly and that FIFO works.
  buf[l] = analogRead(A0); 
  //Serial.println(analogRead(A0));
}


}

int execTimeA = 0;
int intTimeA = 10000;
int currTimeA;

int execTimeD;
int intTimeD = 1500;
int currTimeD;



void loop() {
   //Serial.println(micros());
   currTimeA = micros();

  //if(currTimeA - execTimeA >= intTimeA) {

  for(int p = 0; p < samples - inc; p++) { // This moves each element of the array to the left. (FIFO)
    buf[p] = buf[p+1];
  }
  
  for(int u = inc; u > 0; u--) {
    execTimeA = micros();
    buf[samples - u] = analogRead(A0); // This fills the last element of the array with analogRead() input.
  }
  
  
  for(int a = 0; a < samples; a++) {
    filtered[a] = filtersRT.lowpass(filtersRT.highpass(buf[a], 2, fs), 4, fs); //bandpass filter
  }
  
  
  // Start of hilbert convolution
  
  
    for (k = 0; k < samples; k++)  //  position in output
    {
      tmp = 0;
  
      for (i = 0; i < coefLen; i++)  //  position in coefficients array
      {
        j = k - i;  //  position in input
  
        if (j >= 0)  //  bounds check for input buffer
        {
          tmp += coef[i] * filtered[j + 21];
        }
      }
  
      out[k] = tmp;
    }
  
      for(int p = 0; p < samples; p++){
      if(p < samples - ((coefLen-1)/2)) {
        real[p] = filtered[p];
      }
      if(p > ((coefLen-1)/2)-1){
        imag[p] = out[p] * -1;
      }
    }


  // end of hilbert convolution
  

  //Serial.println(micros());


/*
  
  // all this in this commented out block is graphing for plots. Omitted to preserve real-time processing.
  
  for(int u = inc; u > 0; u--) {
  Serial.print(buf[samples -u]/500);
  Serial.print(",");
  Serial.print(filtered[samples -u]/10);
  Serial.print(",");
  Serial.println(-1 * atan2(real[samples- ((coefLen - 1)/2) - u], imag[samples - ((coefLen - 1)/2) - u]));
  }

*/

double ph = atan2(real[samples- ((coefLen - 1)/2) - 1], imag[samples - ((coefLen - 1)/2) - 1]); // phase calculation
//Serial.println(ph);

desiredPhase = -1.57; // desired phase in radians.

if(ph <= desiredPhase+0.1 && ph >= desiredPhase-0.1) { // a margin of 0.1 radians is used to ensure the desired phase is approximately captured.
  digitalWrite(pinNumber, HIGH);
  delay(2);
  digitalWrite(pinNumber, LOW);
  //Serial.println("done");
}


//Serial.println(micros());
counter++;
}




//}
