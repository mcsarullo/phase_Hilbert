#include "KickFilters.h"
  
double coef[] = {-0.0000,   -0.0029,   -0.0000,   -0.0049,   -0.0000,   -0.0091,   -0.0000,   -0.0162,   -0.0000,   -0.0271,   -0.0000,   -0.0433,   -0.0000,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    0.0029,    0.0000};
int coefLen = 41; 

const uint16_t samples = 200;
float filtered[samples] = {0};
float tmpArr[samples] = {0};

//sine wave of 5 Hz + 30 Hz + 1.5 Hz (HA)
const float input[] = {0,    2.4901,    2.8324,    2.3966,    3.6591,    5.9359,    6.4641,    5.0107,    4.2362,    5.2014,    5.5973,    3.6850,    1.2939,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   -2.6504,   -1.7346};
// noisy sine wave
//const float input[] = {0.0280,   -0.0307,    0.1197,    0.2511,    0.3358,    0.5398,    0.5946,    0.6388,    0.6535,    0.8272,    0.9687,    0.8274,    1.0385,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   -0.4778,   -0.6508};
// sine wave 5 Hz
const float input2[] = {0,    1.1672,    2.2700,    3.2472,    4.0451,    4.6194,    4.9384,    4.9846,    4.7553,    4.2632,    3.5355,    2.6125,    1.5451,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   -1.9134,   -0.7822};

int i, j, k;
double tmp;
double out[] = {0,     0,     0,     0,     0,     0,     0,     0,     0,     0,     0,     0,     0,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     0,     0};
double real[] = {0,     0,     0,     0,     0,     0,     0,     0,     0,     0,     0,     0,     0,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     0,     0};
double imag[] = {0,     0,     0,     0,     0,     0,     0,     0,     0,     0,     0,     0,     0,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     0,     0};
  


const float fs = 133.333333; //sampling frequency in Hertz (Hz)

void setup()
{
  Serial.begin(115200); 
  while(!Serial); //will not run until Serial Monitor or Plotter is open
  //Serial.println(millis());
  KickFilters<float>::bandpass(input, filtered, tmpArr, samples, 4,6, fs); // BANDPASS HERE. Parameters: (input, output, temp (just required, no purpose afterwards), sample #, highpass, lowpass, Samp. Freq.)
    
  for (k = 0; k < samples; k++)  //  position in output
  {
    tmp = 0;

    for (i = 0; i < coefLen; i++)  //  position in coefficients array
    {
      j = k - i;  //  position in input

      if (j >= 0)  //  bounds check for input buffer
      {
        tmp += coef[i] * filtered[j-6];
      }
    }

    out[k] = tmp;
  }
  for(int p = 0; p < samples; p++){
    if(p < samples - ((coefLen-1)/2)) {
      real[p] = filtered[p];
    }
    if(p > ((coefLen-1)/2)-1){
      imag[p] = out[p];
    }
  }

    for(int a = 0; a < samples; a++) {
      // Calculates four-quadrant arctan. This is the equivalent of the angle() function in MATLAB.
      double phase = atan2(imag[a], real[a]);
      Serial.print(phase); 
      Serial.print(","); 
      Serial.println(filtered[a]); 
  }
  //Serial.println(millis());
}

void loop()
{
}
